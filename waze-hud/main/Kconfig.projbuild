## waze-hud/main/Kconfig.projbuild
```kconfig
menu "Waze HUD firmware"

config WAZE_HUD_DISPLAY_CYD_28
    bool
    default y
    help
        This branch is dedicated to the classic ESP32 Cheap Yellow Display.
        It uses the ILI9341 SPI pin map, software landscape rotation and
        320x240 output.

config WAZE_HUD_BOARD_ES3C28P
    bool "Board: LCDWiki ES3C28P/ES3N28P (ESP32-S3, 2.8-inch ILI9341)"
    default n
    help
        Selects the ESP32-S3 pin map for the ES3C28P/ES3N28P board. The
        display is the same ILI9341 240x320 SPI panel as the CYD, so the
        320x240 landscape layout and software rotation are reused.
        Leave disabled for the classic ESP32-2432S028 CYD.

config WAZE_HUD_LCD_INVERT_COLOR
    bool "Enable LCD color inversion (INVON)"
    default y if WAZE_HUD_BOARD_ES3C28P
    default n
    help
        IPS ILI9341 panels usually need INVON for black to render as black.
        Disable if the screen shows inverted colors.

config WAZE_HUD_LCD_RGB_ORDER_BGR
    bool "LCD element order is BGR"
    default y
    help
        Disable if red and blue appear swapped.

config WAZE_HUD_AUDIO_ALERT
    bool "Play an overspeed alert through the on-board speaker"
    depends on WAZE_HUD_BOARD_ES3C28P
    default y
    help
        Uses the ES8311 codec and speaker amplifier of the ES3C28P board.

config WAZE_HUD_AUDIO_VOLUME
    int "Alert volume (percent)"
    depends on WAZE_HUD_AUDIO_ALERT
    range 1 100
    default 70

config WAZE_HUD_AUDIO_REPEAT_SEC
    int "Seconds between repeated alerts while still overspeeding"
    depends on WAZE_HUD_AUDIO_ALERT
    range 2 60
    default 3

config WAZE_HUD_AUDIO_USE_VOICE
    bool "Play the recorded voice clip instead of a beep"
    depends on WAZE_HUD_AUDIO_ALERT
    default n
    help
        Requires main/audio/overspeed_voice.cpp to be generated from a WAV
        file with tools/wav_to_voice_clip.py. Falls back to the beep when
        the clip is empty.

config WAZE_HUD_MOCK_MODE
    bool "Enable renderer mock mode"
    default n
    help
        Cycle deterministic renderer scenarios without requiring a phone.
        Minimum speed remains mock-only; lane guidance also exercises the
        real HLP/1 direction-mask representation.

config WAZE_HUD_DEFAULT_BRIGHTNESS
    int "Default backlight brightness (percent)"
    range 10 100
    default 100
    help
        Must align with the HLP configuration slider's 5 percent step.

config WAZE_HUD_HEADLESS_DIAGNOSTIC
    bool "Disable LCD/UI for watchdog isolation"
    default n
    help
        Keep BLE, HLP, state and configuration active while skipping display
        initialization and the UI task. Intended only for hardware diagnosis.

config WAZE_HUD_UI_TASK_CORE
    int "UI task core"
    range 0 1
    default 1

endmenu
```
